## CMakeLists.txt
```
#
# Copyright (c) 2026 Nordic Semiconductor ASA
#
# SPDX-License-Identifier: LicenseRef-Nordic-5-Clause
#

cmake_minimum_required(VERSION 3.20.0)

find_package(Zephyr REQUIRED HINTS $ENV{ZEPHYR_BASE})
project(esig)

target_sources(app PRIVATE src/main.c)

add_subdirectory(src/saadc_limit)
```

## Kconfig
```
#
# Copyright (c) 2026 Nordic Semiconductor ASA
#
# SPDX-License-Identifier: LicenseRef-Nordic-5-Clause
#

rsource "src/saadc_limit/Kconfig.saadc_limit"

source "Kconfig.zephyr"
```

## prj.conf
```kconfig
#
# Copyright (c) 2026 Nordic Semiconductor ASA
#
# SPDX-License-Identifier: LicenseRef-Nordic-5-Clause
#

CONFIG_SERIAL=y
CONFIG_CONSOLE=y
CONFIG_UART_CONSOLE=y
CONFIG_LOG=y
CONFIG_SHELL=y


# The SAADC limit module drives the SAADC, RTC130 and DPPI through nrfx directly.
CONFIG_NRFX_SAADC=y
CONFIG_NRFX_RTC=y
CONFIG_NRFX_GPPI=y

# The GPIO driver initializes GPIOTE130, which drives the comparator output pin.
CONFIG_GPIO=y
```

## boards/nrf9251dk_nrf9251_cpuapp.overlay
```dts
/*
 * Copyright (c) 2026 Nordic Semiconductor ASA
 *
 * SPDX-License-Identifier: LicenseRef-Nordic-5-Clause
 */

/* RTC130 is driven directly through nrfx_rtc by the SAADC limit module. */
&rtc130 {
	status = "reserved";
};
```

## src/main.c
```c
/*
 * Copyright (c) 2026 Nordic Semiconductor ASA
 *
 * SPDX-License-Identifier: LicenseRef-Nordic-5-Clause
 */

#include <zephyr/kernel.h>
#include <zephyr/logging/log.h>

#include "saadc_limit/saadc_limit.h"

LOG_MODULE_REGISTER(main, LOG_LEVEL_INF);

int main(void)
{
	int err;

	err = saadc_limit_init();
	if (err) {
		LOG_ERR("saadc_limit_init, error: %d", err);
		return err;
	}

	LOG_INF("application started on %s, use \"saadc_limit start <threshold> <hysteresis> <ms>\"",
		CONFIG_BOARD_TARGET);

	return 0;
}
```
