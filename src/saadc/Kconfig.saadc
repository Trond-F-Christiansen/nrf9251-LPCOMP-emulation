## src/saadc/Kconfig.saadc
```kconfig
#
# Copyright (c) 2026 Nordic Semiconductor ASA
#
# SPDX-License-Identifier: LicenseRef-Nordic-5-Clause
#

menuconfig SAADC
	bool "SAADC module"
	select ADC
	help
	  Sample the SAADC channel described by the first io-channels entry of the zephyr,user
	  devicetree node.

if SAADC

config SAADC_SHELL
	bool "SAADC shell commands"
	depends on SHELL
	default y

module = SAADC
module-str = SAADC
source "subsys/logging/Kconfig.template.log_config"

endif # SAADC
```

## src/saadc_limit/Kconfig.saadc_limit
```kconfig
#
# Copyright (c) 2026 Nordic Semiconductor ASA
#
# SPDX-License-Identifier: LicenseRef-Nordic-5-Clause
#

module = SAADC_LIMIT
module-str = SAADC limit
source "subsys/logging/Kconfig.template.log_config"
```
